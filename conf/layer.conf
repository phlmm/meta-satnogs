## conf/layer.conf
```bitbake
# We have a conf and classes directory, add to BBPATH
BBPATH .= ":${LAYERDIR}"

# We have recipes-* directories, add to BBFILES
BBFILES += "${LAYERDIR}/recipes-*/*/*.bb \
            ${LAYERDIR}/recipes-*/*/*.bbappend"

BBFILE_COLLECTIONS += "meta-satnogs"
BBFILE_PATTERN_meta-satnogs = "^${LAYERDIR}/"
BBFILE_PRIORITY_meta-satnogs = "6"

LAYERDEPENDS_meta-satnogs = "core sdr-layer meta-python"
LAYERSERIES_COMPAT_meta-satnogs = "whinlatter"
```
